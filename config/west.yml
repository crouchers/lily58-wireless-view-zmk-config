## config/west.yml
```yaml
manifest:
  remotes:
    - name: zmkfirmware
      url-base: https://github.com/zmkfirmware
    # nice_oled
    - name: kevinpastor
      url-base: https://github.com/kevinpastor
  projects:
    - name: zmk
      remote: zmkfirmware
      revision: main
      import: app/west.yml
    # nice_oled
+   - name: nice-view-elemental
+     remote: kevinpastor
+     revision: main
  self:
    path: config
```
